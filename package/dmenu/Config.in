## package/dmenu/Config.in
```kconfig
config BR2_PACKAGE_DMENU
	bool "dmenu"
	depends on BR2_PACKAGE_XORG7
	depends on BR2_TOOLCHAIN_HAS_THREADS # glib2
	depends on BR2_USE_MMU # glib2
	depends on BR2_USE_WCHAR # glib2
	depends on BR2_TOOLCHAIN_HAS_SYNC_4 # pango -> harfbuzz
	depends on BR2_TOOLCHAIN_GCC_AT_LEAST_4_8 # pango -> harfbuzz
	depends on BR2_INSTALL_LIBSTDCPP # pango -> freetype
	select BR2_PACKAGE_LIBGLIB2
	select BR2_PACKAGE_LIBXML2
	select BR2_PACKAGE_PANGO
	select BR2_PACKAGE_XLIB_LIBX11
	# libxft and libxrender are needed to get xft support in pango
	select BR2_PACKAGE_XLIB_LIBXFT
	select BR2_PACKAGE_XLIB_LIBXRENDER
	help
	  Tiling window manager with extensive standards support.

	  http://dmenu.org

comment "dmenu needs a toolchain w/ C++, threads, wchar, gcc >= 4.8"
	depends on BR2_USE_MMU
	depends on BR2_TOOLCHAIN_HAS_SYNC_4
	depends on !BR2_TOOLCHAIN_HAS_THREADS || !BR2_USE_WCHAR || \
		!BR2_TOOLCHAIN_GCC_AT_LEAST_4_8 || \
		!BR2_INSTALL_LIBSTDCPP
	depends on BR2_PACKAGE_XORG7
```

## package/emacs/Config.in
```kconfig
config BR2_PACKAGE_EMACS
	bool "emacs"
	select BR2_PACKAGE_NCURSES
	help
	  The Emacs Operating System.

	  http://mirror.us-midwest-1.nexcess.net/gnu/emacs/
```

## package/i3wm/Config.in
```kconfig
config BR2_PACKAGE_I3WM
	bool "i3wm"
	depends on BR2_PACKAGE_XORG7
	depends on BR2_TOOLCHAIN_HAS_THREADS # glib2
	depends on BR2_USE_MMU # glib2
	depends on BR2_USE_WCHAR # glib2
        depends on BR2_PACKAGE_LIBEV
	depends on BR2_TOOLCHAIN_HAS_SYNC_4 # pango -> harfbuzz
	depends on BR2_TOOLCHAIN_GCC_AT_LEAST_4_8 # pango -> harfbuzz
	depends on BR2_INSTALL_LIBSTDCPP # pango -> freetype
        depends on BR2_PACKAGE_STARTUP_NOTIFICATION
	depends on BR2_PACKAGE_YAJL
	select BR2_PACKAGE_XCB_UTIL
	select BR2_PACKAGE_XCB_UTIL_CURSOR
	select BR2_PACKAGE_XCB_UTIL_KEYSYMS
	select BR2_PACKAGE_XCB_UTIL_WM
	select BR2_PACKAGE_XCB_UTIL_XRM
	select BR2_PACKAGE_LIBGLIB2
	select BR2_PACKAGE_LIBXML2
	select BR2_PACKAGE_PANGO
	# libxft and libxrender are needed to get xft support in pango
	select BR2_PACKAGE_XLIB_LIBXFT
	select BR2_PACKAGE_XLIB_LIBXRENDER
	help
	  Tiling window manager with extensive standards support.

	  http://i3wm.org

comment "i3wm needs a toolchain w/ C++, threads, wchar, gcc >= 4.8"
	depends on BR2_USE_MMU
	depends on BR2_TOOLCHAIN_HAS_SYNC_4
	depends on !BR2_TOOLCHAIN_HAS_THREADS || !BR2_USE_WCHAR || \
		!BR2_TOOLCHAIN_GCC_AT_LEAST_4_8 || \
		!BR2_INSTALL_LIBSTDCPP
	depends on BR2_PACKAGE_XORG7
```

## package/x11r7/xcb-util-xrm/Config.in
```kconfig
config BR2_PACKAGE_XCB_UTIL_XRM
	bool "xcb-util-xrm"
	help
	  The XCB util modules provides a number of libraries which
	  sit on top of libxcb, the core X protocol library, and some
	  of the extension libraries. These experimental libraries
	  provide convenience functions and interfaces which make the
	  raw X protocol more usable. Some of the libraries also
	  provide client-side code which is not strictly part of the X
	  protocol but which have traditionally been provided by Xlib.

	  http://xcb.freedesktop.org/
```
